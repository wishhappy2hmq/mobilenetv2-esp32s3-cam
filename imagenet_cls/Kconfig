## imagenet_cls/Kconfig
```kconfig
menu "models: imagenet_cls"
    config FLASH_IMAGENET_CLS_MOBILENETV2_S8_V1
        bool "flash image_classifier_320x320_int8"
        depends on !IMAGENET_CLS_MODEL_IN_SDCARD
        default y
        help
            Custom binary classification MobileNetV2 model (320x320 input)

    choice
        prompt "default model"
        default IMAGENET_CLS_MOBILENETV2_S8_V1
        help
            default imagenet_cls model
        config IMAGENET_CLS_MOBILENETV2_S8_V1
            bool "image_classifier_320x320_int8"
            depends on IMAGENET_CLS_MODEL_IN_SDCARD || FLASH_IMAGENET_CLS_MOBILENETV2_S8_V1
    endchoice

    config DEFAULT_IMAGENET_CLS_MODEL
        int
        default 0 if IMAGENET_CLS_MOBILENETV2_S8_V1

    choice
        prompt "model location"
        default IMAGENET_CLS_MODEL_IN_FLASH_RODATA
        help
            imagenet_cls model location
        config IMAGENET_CLS_MODEL_IN_FLASH_RODATA
            bool "flash_rodata"
        config IMAGENET_CLS_MODEL_IN_FLASH_PARTITION
            bool "flash_partition"
        config IMAGENET_CLS_MODEL_IN_SDCARD
            bool "sdcard"
    endchoice

    config IMAGENET_CLS_MODEL_LOCATION
        int
        default 0 if IMAGENET_CLS_MODEL_IN_FLASH_RODATA
        default 1 if IMAGENET_CLS_MODEL_IN_FLASH_PARTITION
        default 2 if IMAGENET_CLS_MODEL_IN_SDCARD

    config IMAGENET_CLS_MODEL_SDCARD_DIR
        string "imagenet_cls model sdcard dir"
        default "models/s3" if IDF_TARGET_ESP32S3
        default "models/p4" if IDF_TARGET_ESP32P4
        depends on IMAGENET_CLS_MODEL_IN_SDCARD
        help
            Directory of models relative to sdcard mount point.
endmenu
```
